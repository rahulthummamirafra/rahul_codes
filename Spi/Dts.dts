/dts-v1/;
/plugin/;

/ {
    compatible = "brcm,bcm2711";

    fragment@0 {
        target = <&spi0>;
        __overlay__ {
            status = "okay";

            ili9225@0 {
                compatible = "ilitek,ili9225";
                reg = <0>;  // CE0

                spi-max-frequency = <20000000>;

                dc-gpios = <&gpio 25 0>;
                reset-gpios = <&gpio 24 0>;
            };
        };
    };
};
